## initramfs/buildroot/configs/sp7350_defconfig
```kconfig
BR2_aarch64=y
BR2_cortex_a55=y
BR2_KERNEL_HEADERS_5_10=y
BR2_PACKAGE_GLIBC_UTILS=y
BR2_TOOLCHAIN_BUILDROOT_CXX=y
BR2_GCC_ENABLE_GRAPHITE=y
BR2_INIT_SYSTEMD=y
BR2_SYSTEM_BIN_SH_BASH=y
BR2_PACKAGE_FFMPEG_FFPROBE=y
BR2_PACKAGE_FFMPEG_AVRESAMPLE=y
BR2_PACKAGE_GSTREAMER1=y
BR2_PACKAGE_GSTREAMER1_CHECK=y
BR2_PACKAGE_GST1_PLUGINS_BASE_PLUGIN_AUDIOTESTSRC=y
# BR2_PACKAGE_GST1_PLUGINS_BASE_PLUGIN_PLAYBACK is not set
BR2_PACKAGE_GST1_PLUGINS_BASE_PLUGIN_RAWPARSE=y
BR2_PACKAGE_GST1_PLUGINS_BASE_PLUGIN_VIDEOTESTSRC=y
# BR2_PACKAGE_GST1_PLUGINS_BASE_PLUGIN_VOLUME is not set
BR2_PACKAGE_GST1_PLUGINS_BASE_PLUGIN_ALSA=y
BR2_PACKAGE_GST1_PLUGINS_BASE_PLUGIN_OPUS=y
BR2_PACKAGE_GST1_PLUGINS_BASE_PLUGIN_PANGO=y
BR2_PACKAGE_GST1_PLUGINS_GOOD=y
BR2_PACKAGE_GST1_PLUGINS_GOOD_JPEG=y
BR2_PACKAGE_GST1_PLUGINS_GOOD_PLUGIN_AUDIOPARSERS=y
# BR2_PACKAGE_GST1_PLUGINS_GOOD_PLUGIN_AVI is not set
BR2_PACKAGE_GST1_PLUGINS_GOOD_PLUGIN_MATROSKA=y
BR2_PACKAGE_GST1_PLUGINS_GOOD_PLUGIN_MULTIFILE=y
BR2_PACKAGE_GST1_PLUGINS_GOOD_PLUGIN_WAVENC=y
BR2_PACKAGE_GST1_PLUGINS_GOOD_PLUGIN_V4L2=y
BR2_PACKAGE_GST1_PLUGINS_GOOD_PLUGIN_V4L2_PROBE=y
BR2_PACKAGE_GST1_PLUGINS_BAD=y
BR2_PACKAGE_GST1_PLUGINS_BAD_PLUGIN_JPEGFORMAT=y
BR2_PACKAGE_GST1_PLUGINS_BAD_PLUGIN_FDK_AAC=y
BR2_PACKAGE_GST1_PLUGINS_BAD_PLUGIN_OPENH264=y
BR2_PACKAGE_GST1_PLUGINS_BAD_PLUGIN_OPENJPEG=y
BR2_PACKAGE_GST1_PLUGINS_BAD_PLUGIN_V4L2CODECS=y
BR2_PACKAGE_GST1_PLUGINS_UGLY=y
BR2_PACKAGE_GST1_PLUGINS_UGLY_PLUGIN_X264=y
BR2_PACKAGE_GST1_LIBAV=y
BR2_PACKAGE_GDB=y
BR2_PACKAGE_STRACE=y
BR2_PACKAGE_FINDUTILS=y
BR2_PACKAGE_GREP=y
BR2_PACKAGE_SED=y
BR2_PACKAGE_TREE=y
BR2_PACKAGE_E2FSPROGS=y
BR2_PACKAGE_E2FSPROGS_RESIZE2FS=y
BR2_PACKAGE_I2C_TOOLS=y
BR2_PACKAGE_PYTHON3=y
BR2_PACKAGE_PYTHON_PIP=y
BR2_PACKAGE_LIBDRM=y
BR2_PACKAGE_LIBDRM_INSTALL_TESTS=y
BR2_PACKAGE_LIBV4L=y
BR2_PACKAGE_LIBV4L_UTILS=y
BR2_PACKAGE_BC=y
BR2_PACKAGE_DHCP=y
BR2_PACKAGE_DHCP_RELAY=y
BR2_PACKAGE_DHCP_CLIENT=y
BR2_PACKAGE_DHCPCD=y
BR2_PACKAGE_ETHTOOL=y
BR2_PACKAGE_IPERF3=y
BR2_PACKAGE_IPUTILS=y
BR2_PACKAGE_IW=y
BR2_PACKAGE_NET_TOOLS=y
BR2_PACKAGE_OPENSSH=y
BR2_PACKAGE_RSYNC=y
BR2_PACKAGE_SSHPASS=y
BR2_PACKAGE_TCPDUMP=y
BR2_PACKAGE_WGET=y
BR2_PACKAGE_WIRELESS_TOOLS=y
BR2_PACKAGE_WPA_SUPPLICANT=y
BR2_PACKAGE_WPA_SUPPLICANT_AUTOSCAN=y
BR2_PACKAGE_WPA_SUPPLICANT_WPA3=y
BR2_PACKAGE_WPA_SUPPLICANT_CLI=y
BR2_PACKAGE_WPA_SUPPLICANT_WPA_CLIENT_SO=y
BR2_PACKAGE_BASH_LOADABLE_EXAMPLES=y
BR2_PACKAGE_BASH_COMPLETION=y
BR2_PACKAGE_DIALOG=y
BR2_PACKAGE_FILE=y
BR2_PACKAGE_TIME=y
BR2_PACKAGE_WHICH=y
BR2_PACKAGE_COREUTILS=y
BR2_PACKAGE_COREUTILS_INDIVIDUAL_BINARIES=y
BR2_PACKAGE_SYSTEMD_INITRD=y
BR2_PACKAGE_SYSTEMD_ANALYZE=y
BR2_PACKAGE_SYSTEMD_COREDUMP=y
BR2_PACKAGE_SYSTEMD_LOGIND=y
BR2_PACKAGE_SYSTEMD_RFKILL=y
BR2_PACKAGE_TAR=y
BR2_PACKAGE_UTIL_LINUX_HWCLOCK=y
BR2_PACKAGE_UTIL_LINUX_KILL=y
BR2_PACKAGE_UTIL_LINUX_NOLOGIN=y
BR2_PACKAGE_UTIL_LINUX_RFKILL=y
BR2_PACKAGE_UTIL_LINUX_SWITCH_ROOT=y
BR2_PACKAGE_NANO=y
BR2_TARGET_ROOTFS_EXT2=y
BR2_TARGET_ROOTFS_EXT2_4=y
BR2_TARGET_ROOTFS_EXT2_SIZE="3072M"
```

## initramfs/buildroot/package/swupdate/Config.in
```kconfig
config BR2_PACKAGE_SWUPDATE
	bool "swupdate"
	depends on !BR2_STATIC_LIBS
	depends on BR2_TOOLCHAIN_HAS_THREADS
	depends on BR2_USE_MMU # fork()
	depends on BR2_TOOLCHAIN_HAS_SYNC_4 # json-c
	select BR2_PACKAGE_JSON_C
	select BR2_PACKAGE_LIBUBOOTENV
	select BR2_PACKAGE_CPIO
	select BR2_PACKAGE_LIBCONFIG
	select BR2_PACKAGE_LIBOPENSSL
	select BR2_PACKAGE_LIBOPENSSL_BIN
	select BR2_PACKAGE_MBEDTLS
	select BR2_PACKAGE_WOLFSSL
	help
	  swupdate provides a reliable way to update the software on
	  an embedded system.

	  swupdate is highly configurable to fit the targets
	  requirements and to minimize the footprint. The provided
	  default configuration file BR2_PACKAGE_SWUPDATE_CONFIG will
	  enable swupdate with an embedded webserver, a parser and a
	  handler for raw NAND or NOR flash.

	  The default configuration file builds a reasonable firmware
	  update system with minimal external dependencies in mind.
	  If you like to use your own modified configuration,
	  you have to select the necessary packages manually:

	  * Select BR2_PACKAGE_LUA or BR2_PACKAGE_LUAJIT if you want
	    want to have Lua support.
	  * Select BR2_PACKAGE_LIBCURL if you want to use the download
	    feature.
	  * Select BR2_PACKAGE_OPENSSL or BR2_PACKAGE_MBEDTLS if you
	    want to add encryption support.
	  * Select BR2_PACKAGE_MTD if you want to use swupdate with
	    UBI partitions.
	  * Select BR2_PACKAGE_ZLIB if you want to deal with gzip
	    compressed archives.
	  * Select BR2_PACKAGE_ZSTD if you want to deal with zstd
	    compressed archives.
	  * Select BR2_PACKAGE_ZEROMQ to add support for using a
	    remote handler.
	  * Select BR2_PACKAGE_LIBRSYNC to add support for using
	    rdiff handler.
	  * Select BR2_PACKAGE_LIBGPIOD to add support for
	    microcontroller firmware update.
	  * Select BR2_PACKAGE_EFIBOOTMGR to add support for EFI Boot
	    Guard.
	  * Select BR2_PACKAGE_LIBCURL, BR2_PACKAGE_LIBWEBSOCKETS,
	    and BR2_PACKAGE_LIBURIPARSER
	    to add support for the SWU forwarder.

	  https://sbabic.github.io/swupdate

if BR2_PACKAGE_SWUPDATE

config BR2_PACKAGE_SWUPDATE_CONFIG
	string "swupdate configuration file"
	default "package/swupdate/swupdate.config"
	help
	  Path to the swupdate configuration file.

	  I you wish to use your own modified swupdate configuration
	  file specify the config file location with this option.

config BR2_PACKAGE_SWUPDATE_USB
	bool "swupdate usb"
	depends on BR2_PACKAGE_SYSTEMD
	help
	  Enable update from USB disk.

comment "swupdate usb needs systemd"
	depends on !BR2_PACKAGE_SYSTEMD

config BR2_PACKAGE_SWUPDATE_WEBSERVER
	bool "swupdate webserver"
	default y
	help
	  Enable update from remote using a web server on the target.

config BR2_PACKAGE_SWUPDATE_INSTALL_WEBSITE
	bool "install default website"
	default y
	depends on BR2_PACKAGE_SWUPDATE_WEBSERVER
	help
	  Install the provided website to /var/www/swupdate.

	  This is necessary if you want to run swupdate with the
	  embedded webserver and do not provide an own website to be
	  installed to /var/www/swupdate.

config BR2_PACKAGE_SWUPDATE_HW_COMPATIBILITY
	bool "swupdate check for hw / sw compatibility"
	default y
	help
	  Enable checking hardware / software compatibility

choice
	prompt "select SSL implementation"
	default BR2_PACKAGE_SWUPDATE_SSL_IMPL_OPENSSL
	help
	  Select SSL implementation for hashing, verifying and decrypting images.

	config BR2_PACKAGE_SWUPDATE_SSL_IMPL_NONE
		bool "None"

	config BR2_PACKAGE_SWUPDATE_SSL_IMPL_OPENSSL
		bool "OpenSSL"
		depends on BR2_PACKAGE_OPENSSL

	config BR2_PACKAGE_SWUPDATE_SSL_IMPL_WOLFSSL
		bool "wolfSSL (with OpenSSL compatibility layer)"
		depends on BR2_PACKAGE_WOLFSSL
		select BR2_PACKAGE_SWUPDATE_CMS_IGNORE_CERTIFICATE_PURPOSE
		select BR2_PACKAGE_SWUPDATE_CMS_SKIP_UNKNOWN_SIGNERS

	config BR2_PACKAGE_SWUPDATE_SSL_IMPL_MBEDTLS
		bool "mbedTLS"
		depends on BR2_PACKAGE_MBEDTLS
endchoice

config BR2_PACKAGE_SWUPDATE_HASH_VERIFY
	bool "add sha256 hash to each image"
	default y
	depends on BR2_PACKAGE_SWUPDATE_SSL_IMPL_OPENSSL || BR2_PACKAGE_SWUPDATE_SSL_IMPL_WOLFSSL || BR2_PACKAGE_SWUPDATE_SSL_IMPL_MBEDTLS
	help
	  Allow to add a sha256 hash to an artifact.
	  This is automatically set in case of Signed Image

config BR2_PACKAGE_SWUPDATE_SIGNED_IMAGES
	bool "Enable verification of signed images"
	default y
	depends on BR2_PACKAGE_SWUPDATE_SSL_IMPL_OPENSSL || BR2_PACKAGE_SWUPDATE_SSL_IMPL_WOLFSSL || BR2_PACKAGE_SWUPDATE_SSL_IMPL_MBEDTLS
	select BR2_PACKAGE_SWUPDATE_HASH_VERIFY

choice
	prompt "Signature verification algorithm"
	default BR2_PACKAGE_SWUPDATE_SIGALG_CMS
	depends on BR2_PACKAGE_SWUPDATE_SIGNED_IMAGES
	help
	  Select if the signature algorithm for signed images is a raw RSA signature
	  (following PKCS#1.5) or if it uses Cryptographic Message Syntax (CMS) with
	  OpenSSL/LibreSSL.

	config BR2_PACKAGE_SWUPDATE_SIGALG_RAWRSA
		bool "RSA PKCS#1.5"

	config BR2_PACKAGE_SWUPDATE_SIGALG_RSAPSS
		bool "RSA PSS"

	config BR2_PACKAGE_SWUPDATE_SIGALG_CMS
		bool "Cryptographic Message Syntax (CMS) / PKCS#7"
		depends on BR2_PACKAGE_SWUPDATE_SSL_IMPL_OPENSSL || BR2_PACKAGE_SWUPDATE_SSL_IMPL_WOLFSSL

	config BR2_PACKAGE_SWUPDATE_SIGALG_GPG
		bool "GPG signing"
endchoice

menu "CMS / PKCS#7 signature verification options"
	depends on BR2_PACKAGE_SWUPDATE_SIGALG_CMS

config BR2_PACKAGE_SWUPDATE_CMS_IGNORE_EXPIRED_CERTIFICATE
	bool "Ignore expired certificates"
	depends on BR2_PACKAGE_SWUPDATE_SIGALG_CMS

config BR2_PACKAGE_SWUPDATE_CMS_IGNORE_CERTIFICATE_PURPOSE
	bool "Ignore X.509 certificate purpose"
	depends on BR2_PACKAGE_SWUPDATE_SIGALG_CMS

config BR2_PACKAGE_SWUPDATE_CMS_SKIP_UNKNOWN_SIGNERS
	bool "Ignore unverifiable signatures if known signer verifies"
	depends on BR2_PACKAGE_SWUPDATE_SIGALG_CMS
endmenu
endif

comment "swupdate needs a toolchain w/ dynamic library, threads"
	depends on BR2_USE_MMU
	depends on BR2_TOOLCHAIN_HAS_SYNC_4
	depends on BR2_STATIC_LIBS || !BR2_TOOLCHAIN_HAS_THREADS
```

## initramfs/yocto/meta-sunplus/conf/layer.conf
```bitbake
LCONF_VERSION = "7"

BBPATH .= ":${LAYERDIR}"

BBFILES += "${LAYERDIR}/recipes-*/*/*.bb \
            ${LAYERDIR}/recipes-*/*/*.bbappend"

BBFILE_COLLECTIONS += "sunplus"
BBFILE_PATTERN_sunplus = "^${LAYERDIR}/"
BBFILE_PRIORITY_sunplus = "6"

LAYERSERIES_COMPAT_sunplus = "mickledore"
```

## initramfs/yocto/sp7350_build/conf/bblayers.conf
```bitbake
# LAYER_CONF_VERSION is increased each time build/conf/bblayers.conf
# changes incompatibly
LCONF_VERSION = "7"

BBPATH = "${TOPDIR}"
BBFILES ?= ""

BBLAYERS = " \
  ${TOPDIR}/../meta \
  ${TOPDIR}/../meta-poky \
  ${TOPDIR}/../meta-yocto-bsp \
  ${TOPDIR}/../meta-sunplus \
  ${TOPDIR}/../meta-qt5 \
  ${TOPDIR}/../meta-swupdate \
"

BBLAYERS += " \
  ${TOPDIR}/../meta-openembedded/meta-multimedia \
  ${TOPDIR}/../meta-openembedded/meta-networking \
  ${TOPDIR}/../meta-openembedded/meta-oe \
  ${TOPDIR}/../meta-openembedded/meta-perl \
  ${TOPDIR}/../meta-openembedded/meta-python \
  ${TOPDIR}/../meta-openembedded/meta-webserver \
  ${TOPDIR}/../meta-openembedded/meta-gnome \
  ${TOPDIR}/../meta-openembedded/meta-xfce \
  ${TOPDIR}/../meta-openembedded/meta-filesystems \
  "
```

## initramfs/yocto/sp7350_build/conf/distro/v1.conf
```bitbake
DISTRO_NAME = "SP7350 EV board"
DISTRO_VERSION = "1.0-${DATE}"
DISTRO_CODENAME = "mickledore"
SDK_VENDOR = "-sp7350sdk"
SDK_VERSION = "${@d.getVar('DISTRO_VERSION').replace('snapshot-${DATE}', 'snapshot')}"

MAINTAINER = "jacky.hsieh <jacky.hsieh@sunplus.com>"
PACKAGE_CLASSES += " package_deb"
IMAGE_FEATURES += "package-management"
TARGET_VENDOR = "-${DISTRO}"

LOCALCONF_VERSION = "1.0"

require conf/distro/include/no-static-libs.inc

# OELAYOUT_ABI allows us to notify users when the format of TMPDIR changes in 
# an incompatible way. Such changes should usually be detailed in the commit
# that breaks the format and have been previously discussed on the mailing list 
# with general agreement from the core team.
#
# OELAYOUT_ABI = "12"

# add poky sanity bbclass
INHERIT += "poky-sanity"

DISTRO_FEATURES:append = " systemd"
DISTRO_FEATURES:append = " shadow"

VIRTUAL-RUNTIME_login_manager = "shadow-base"
VIRTUAL-RUNTIME_init_manager = "systemd"
VIRTUAL-RUNTIME_initscripts = ""
VIRTUAL-RUNTIME_dev_manager = "udev"
VIRTUAL-RUNTIME_cron = "cronie"
VIRTUAL-RUNTIME_pm = "package-manager"

# needed for systemd /

DISTRO_FEATURES:append = "bluez5 bluetooth wifi 3g polkit"
DISTRO_FEATURES:append = "usrmerge pam"
DISTRO_FEATURES:remove = "sysvinit"

# DISTRO_FEATURES:append = "opengl wayland"
# DISTRO_FEATURES:append = "x11 vulkan"
```

## initramfs/yocto/sp7350_build/conf/machine/sp7350.conf
```bitbake
DEFAULTTUNE ?= "cortexa55"
require ${TOPDIR}/../meta/conf/machine/include/arm/armv8-2a/tune-cortexa55.inc

# TUNE_ARCH = "arm64"

# # ARM64 A55 core machine configuration

# TARGET_ARCH = "aarch64"
# # TARGET_FPU = "soft"

# # Specify CPU and architecture

# TUNE_PKGARCH = "cortexa55"
# TUNE_FEATURES = "armv8 crc"

TARGET_CFLAGS:append = " -fdata-sections"
SERIAL_TERM = "xterm"

    
```
